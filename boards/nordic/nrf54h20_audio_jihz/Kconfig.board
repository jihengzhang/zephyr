## boards/nordic/nrf54h20_audio_jihz/Kconfig.board
```kconfig
# Copyright (c) 2024 Nordic Semiconductor ASA
# SPDX-License-Identifier: Apache-2.0

config BOARD_NRF54H20_AUDIO_JIHZ
	bool "nRF54H20 Audio JIHZ"
	depends on SOC_NRF54H20
	select ARM
	help
	  Enable support for the custom nRF54H20 Audio JIHZ board.
```

## boards/nordic/nrf54h20_audio_jihz/Kconfig.defconfig
```kconfig
# Copyright (c) 2024 Nordic Semiconductor ASA
# SPDX-License-Identifier: Apache-2.0

if BOARD_NRF54H20_AUDIO_JIHZ

config BOARD
	default "nrf54h20_audio_jihz"

endif # BOARD_NRF54H20_AUDIO_JIHZ
```

## boards/nordic/nrf54h20_audio_jihz/nrf54h20_audio_jihz_defconfig
```kconfig
# SPDX-License-Identifier: Apache-2.0

# SOC/Board configuration (like nRF5340 Audio DK)
CONFIG_SOC_SERIES_NRF54HX=y
CONFIG_SOC_NRF54H20=y
CONFIG_BOARD_NRF54H20_AUDIO_JIHZ=y

# Enable MPU
CONFIG_ARM_MPU=y

# Enable hardware stack protection
CONFIG_HW_STACK_PROTECTION=y

# Enable GPIO
CONFIG_GPIO=y

# Enable UART
CONFIG_SERIAL=y
CONFIG_UART_INTERRUPT_DRIVEN=y

# Enable console
CONFIG_CONSOLE=y
CONFIG_UART_CONSOLE=y

# Enable I2S
CONFIG_I2S=y

# Enable I2C
CONFIG_I2C=y

# Enable SPI
CONFIG_SPI=y

# Enable USB
CONFIG_USB_DEVICE_STACK=y

# Enable power management
CONFIG_PM=y
CONFIG_PM_DEVICE=y

# Enable audio
CONFIG_AUDIO=y
CONFIG_AUDIO_CODEC=y

# Enable Bluetooth
CONFIG_BT=y
CONFIG_BT_PERIPHERAL=y
CONFIG_BT_AUDIO=y
CONFIG_BT_PAC_SNK=y
CONFIG_BT_AUDIO_UNICAST=y
CONFIG_BT_AUDIO_UNICAST_CLIENT=y

# Logging
CONFIG_LOG=y
CONFIG_LOG_DEFAULT_LEVEL=3
```
